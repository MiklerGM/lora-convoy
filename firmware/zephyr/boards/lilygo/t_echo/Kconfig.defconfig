## firmware/zephyr/boards/lilygo/t_echo/Kconfig.defconfig
```kconfig
if BOARD_T_ECHO

source "boards/common/usb/Kconfig.cdc_acm_serial.defconfig"

endif # BOARD_T_ECHO
```

## firmware/zephyr/boards/lilygo/t_echo/board.yml
```yaml
board:
  name: t_echo
  full_name: T-Echo
  vendor: lilygo
  socs:
  - name: nrf52840
```
